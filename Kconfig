## dts/bindings/input_processors/measlesbagel,zpt-input-processor-sensor-control-proxy.yaml
```yaml
# SPDX-License-Identifier: MIT

description: >
  Central-side decoder for split sensor-control responses. Place it first in
  an endpoint's input-processor chain so packed control frames are consumed
  before anything else observes them.

compatible: "measlesbagel,zpt-input-processor-sensor-control-proxy"

include: ip_zero_param.yaml

properties:
  agent:
    type: phandle
    required: true
    description: Sensor-control behavior device relaying requests on this split
```

## dts/bindings/input_processors/measlesbagel,zpt-input-processor-sign-extend-xy.yaml
```yaml
# SPDX-License-Identifier: MIT

description: Restore signed 16-bit X/Y values after a packed split transport

compatible: "measlesbagel,zpt-input-processor-sign-extend-xy"

include: ip_zero_param.yaml
```

## dts/bindings/input_processors/measlesbagel,zpt-input-processor-source.yaml
```yaml
# SPDX-License-Identifier: MIT

description: Frame-aware motion source ingress feeding one pointing-tool router

compatible: "measlesbagel,zpt-input-processor-source"

include: ip_zero_param.yaml

properties:
  source-id:
    type: int
    required: true
    description: Stable identity for raw motion received by this ingress

  resolution-cpi:
    type: int
    description: >
      Compiled sensor resolution used for source metadata. Required unless
      device is set, in which case it defaults to that entry's
      resolution-cpi.

  device:
    type: phandle
    description: >
      The measlesbagel,zpt-pointing-device entry for the sensor feeding this
      source. Frames are then labelled with the entry's current resolution,
      so a CPI preview from the tuner changes cursor speed without
      rescaling millimetre-based thresholds. The change applies at the next
      frame boundary.

  router:
    type: phandle
    required: true
    description: Router receiving reconstructed canonical source frames

  transported:
    type: boolean
    description: Mark source frames as having crossed split transport

  compact-event-code:
    type: int
    description: Relative event code carrying a compact complete split frame

  compact-transport-coalesced:
    type: boolean
    description: Mark decoded compact frames as source-coalesced
```

## dts/bindings/input_processors/measlesbagel,zpt-input-processor-text-nav.yaml
```yaml
# SPDX-License-Identifier: MIT

description: Gesture-locked relative X/Y movement to directional behavior processor

compatible: "measlesbagel,zpt-input-processor-text-nav"

include: ip_zero_param.yaml

properties:
  tuning-label:
    type: string
    default: "Text navigation"
    description: Host-facing name used by the optional runtime tuner

  horizontal-threshold:
    type: int
    required: true
    description: Horizontal movement counts required for one directional behavior tap

  vertical-threshold:
    type: int
    required: true
    description: Vertical movement counts required for one directional behavior tap

  bindings:
    type: phandle-array
    required: true
    description: Left, right, up, and down behaviors, in that order

  tap-ms:
    type: int
    required: true
    description: Time between each queued behavior press and release

  idle-timeout-ms:
    type: int
    required: true
    description: Inactivity duration that ends the current directional gesture

  activation-distance:
    type: int
    required: true
    description: Accumulated distance required before choosing an axis

  engage-ratio-percent:
    type: int
    required: true
    description: Dominant-to-minor movement ratio required to lock an axis
```

## dts/bindings/input_processors/measlesbagel,zpt-input-processor-trace.yaml
```yaml
# SPDX-License-Identifier: MIT

description: Pass-through processor that records complete relative-input frames

compatible: "measlesbagel,zpt-input-processor-trace"

include: ip_zero_param.yaml

properties:
  pointing-device-id:
    type: int
    required: true
    description: Stable host-visible identifier for the originating pointing device

  stage:
    type: int
    required: true
    description: Processing stage identifier, conventionally 0 for raw and 1 for output

  label:
    type: string
    required: true
    description: Human-readable stream label advertised to host tools
```

## dts/bindings/measlesbagel,zpt-keypress-suppression.yaml
```yaml
# SPDX-License-Identifier: MIT

description: Shared keypress suppression policy for composed pointing pipelines

compatible: "measlesbagel,zpt-keypress-suppression"

properties:
  stable-id:
    type: string
    description: >
      Identity the tuner shows for this guard. Defaults to the node name.

  suppress-after-keypress-ms:
    type: int
    required: true
    description: Suppression window after any physical keypress
```

## dts/bindings/measlesbagel,zpt-pipeline-telemetry.yaml
```yaml
# SPDX-License-Identifier: MIT

description: Stage observer telemetry for composed pipelines

compatible: "measlesbagel,zpt-pipeline-telemetry"

properties:
  pipelines:
    type: phandles
    required: true
    description: Pipelines whose stages are observed and reported by stable identity
```

## dts/bindings/measlesbagel,zpt-pipeline.yaml
```yaml
# SPDX-License-Identifier: MIT

description: Named ordered pointing-tool pipeline

compatible: "measlesbagel,zpt-pipeline"

properties:
  stable-id:
    type: string
    required: true
    description: Stable identity unique within the owning router

  stages:
    type: phandles
    required: true
    description: Ordered references to independently allocated pointing-tool stages

  sink:
    type: phandle
    required: true
    description: Independently allocated terminal sink for this pipeline

  dispatch-budget:
    type: int
    default: 16
    description: Maximum stage and sink visits allowed for one pipeline operation
```

## dts/bindings/measlesbagel,zpt-pointing-device.yaml
```yaml
# SPDX-License-Identifier: MIT

description: >
  Physical pointing device discovery entry. Entries are compiled into every
  half of a split keyboard from the same devicetree source so numeric ids and
  stable ids agree without runtime negotiation.

compatible: "measlesbagel,zpt-pointing-device"

properties:
  stable-id:
    type: string
    required: true
    description: Cross-half identity used by the device table and host tooling

  sensor:
    type: phandle
    required: true
    description: Backing sensor driver device

  location:
    type: int
    default: 0
    description: >
      Which half owns the device: 0 for central-local, otherwise the owning
      split peripheral index plus one.

  resolution-cpi:
    type: int
    required: true
    description: Compiled default resolution in counts per inch (fits a u16)

  cpi-values:
    type: array
    description: >
      Ascending discrete supported resolutions, each fitting a u16; the
      settable form. Mutually exclusive with the range properties.

  cpi-min:
    type: int
    description: >
      Inclusive minimum supported resolution of the stepped-range settable
      form. Requires cpi-max; mutually exclusive with cpi-values.

  cpi-max:
    type: int
    description: Inclusive maximum supported resolution of the range form

  cpi-step:
    type: int
    default: 1
    description: Lattice step above cpi-min; requires cpi-min and cpi-max
```

## dts/bindings/measlesbagel,zpt-router.yaml
```yaml
# SPDX-License-Identifier: MIT

description: Layer-aware router for named pointing-tool pipelines

compatible: "measlesbagel,zpt-router"

properties:
  stable-id:
    type: string
    required: true
    description: Stable router identity used by telemetry and tuning

  pipelines:
    type: phandles
    required: true
    description: Complete set of independently allocated pipelines owned by this router

  default-pipeline:
    type: phandle
    required: true
    description: Pipeline selected when no configured route layer is active

child-binding:
  description: Route selected while any listed keymap layer is active

  properties:
    layers:
      type: array
      required: true
      description: Keymap layer indexes selecting this route

    pipeline:
      type: phandle
      required: true
      description: Pipeline selected by these layers
```

## dts/bindings/measlesbagel,zpt-sensor-control-proxy.yaml
```yaml
# SPDX-License-Identifier: MIT

description: >
  Central-side relay for split sensor control. Sends CPI requests for
  peripheral-owned pointing devices to the agent behavior on the owning half
  and listens for the agent's packed responses on a zmk,input-split device.
  Built on the central only; declare at most one.

compatible: "measlesbagel,zpt-sensor-control-proxy"

properties:
  agent:
    type: phandle
    required: true
    description: >
      The measlesbagel,zpt-sensor-control behavior to invoke on the owning
      half. ZMK's split relay carries at most eight characters of behavior
      name, so the agent's node name must be eight characters or fewer.

  input:
    type: phandle
    required: true
    description: >
      The zmk,input-split node whose device is the agent behavior. Give it a
      reg that no other split input uses.
```

## dts/bindings/measlesbagel,zpt-sink-action.yaml
```yaml
# SPDX-License-Identifier: MIT

description: ZMK action sink invoking bound keymap behaviors

compatible: "measlesbagel,zpt-sink-action"

properties:
  stable-id:
    type: string
    required: true
    description: Stable identity unique within the owning pipeline

  bindings:
    type: phandle-array
    required: true
    description: Left, right, up, and down behaviors, in that order

  tap-ms:
    type: int
    default: 0
    description: Delay before the queued press is released
```

## dts/bindings/measlesbagel,zpt-sink-cursor.yaml
```yaml
# SPDX-License-Identifier: MIT

description: Thin synchronized ZMK cursor output sink

compatible: "measlesbagel,zpt-sink-cursor"

properties:
  stable-id:
    type: string
    required: true
    description: Stable identity unique within the owning pipeline
```

## dts/bindings/measlesbagel,zpt-sink-scroll.yaml
```yaml
# SPDX-License-Identifier: MIT

description: Thin synchronized ZMK scroll output sink

compatible: "measlesbagel,zpt-sink-scroll"

properties:
  stable-id:
    type: string
    required: true
    description: Stable identity unique within the owning pipeline
```

## dts/bindings/measlesbagel,zpt-stage-axis-constraint.yaml
```yaml
# SPDX-License-Identifier: MIT

description: Axis-constraint stage applying the intent annotation over raw motion

compatible: "measlesbagel,zpt-stage-axis-constraint"

include: measlesbagel,zpt-stage-base.yaml

properties:
  discard-unclassified:
    type: boolean
    description: Discard buffered undecided motion on flush instead of folding it as free

  idle-timeout-ms:
    type: int
    description: Gap after which buffered undecided motion is folded or discarded

  fold-interval-ms:
    type: int
    description: Cadence for folding or discarding buffered undecided motion; else idle-timeout-ms

  suppression:
    type: phandle
    description: Keypress suppression policy clearing buffered motion while active
```

## dts/bindings/measlesbagel,zpt-stage-axis-intent.yaml
```yaml
# SPDX-License-Identifier: MIT

description: Semantic-neutral axis-intent estimator stage over normalized motion

compatible: "measlesbagel,zpt-stage-axis-intent"

include: measlesbagel,zpt-stage-base.yaml

properties:
  policy:
    type: int
    required: true
    description: 0 free, 1 adaptive, 2 horizontal, or 3 vertical policy

  engage-ratio-percent:
    type: int
    required: true
    description: Major axis dominance required to engage an intent

  release-ratio-percent:
    type: int
    required: true
    description: Major axis dominance required to hold an engaged intent

  activation-distance-micrometers:
    type: int
    required: true
    description: Total windowed energy required before intent classification

  window-ms:
    type: int
    required: true
    description: Energy decay window used for intent classification
```

## dts/bindings/measlesbagel,zpt-stage-base.yaml
```yaml
# SPDX-License-Identifier: MIT

description: Common properties for a composable pointing-tool stage

properties:
  stable-id:
    type: string
    required: true
    description: Stable identity unique within the owning pipeline
```
