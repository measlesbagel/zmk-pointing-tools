## Kconfig
```kconfig
DT_COMPAT_ZPT_TELEMETRY := measlesbagel,zpt-telemetry
DT_COMPAT_ZPT_ROUTER := measlesbagel,zpt-router
DT_COMPAT_ZPT_DEVICE_TABLE := measlesbagel,zpt-pointing-device
DT_COMPAT_ZPT_SENSOR_TUNNEL := measlesbagel,zpt-sensor-control
DT_COMPAT_ZPT_PAW3222 := pixart,paw3222
DT_COMPAT_ZPT_ROUTE_BEHAVIOR := measlesbagel,zpt-behavior-route
DT_COMPAT_ZPT_COMPACT_SPLIT_ENCODER := measlesbagel,zpt-input-processor-compact-split-encoder
DT_CHOSEN_ZPT_TELEMETRY_UART := measlesbagel,zpt-telemetry-uart

menu "ZMK Pointing Tools"

config ZMK_POINTING_TOOLS_PIPELINE
    bool "Composable motion pipeline boundary"
    default $(dt_compat_enabled,$(DT_COMPAT_ZPT_ROUTER))
    depends on ZMK_POINTING
    depends on INPUT_MODE_THREAD
    depends on !ZMK_SPLIT || ZMK_SPLIT_ROLE_CENTRAL
    help
      Reconstruct synchronized X/Y frames with source identity, transport, and
      CPI metadata; route them through ordered devicetree pipeline
      compositions; apply explicit enter/leave lifecycle on ZMK layer changes;
      schedule stateful-stage deadlines; and emit terminal output through the
      router's virtual input device. Cursor, scroll, and text pipelines share
      the same estimator, constraint, transfer, quantizer, and batching
      stages, with a keypress suppression guard participating in every
      pass/buffer/drop decision.

# Pipelines run on Zephyr's input thread, next to the input listener, the
# processors before them, the router, and telemetry observers. Stages run one
# after another rather than nested, so pipeline length does not add stack, but
# Zephyr's 1 KiB default leaves no headroom; an overflow there silently
# corrupts neighbouring thread stacks such as the Bluetooth controller's.
config INPUT_THREAD_STACK_SIZE
    default 2048 if ZMK_POINTING_TOOLS_PIPELINE

config ZMK_POINTING_TOOLS_ROUTE_BEHAVIOR
    bool "Momentary pointing pipeline route behavior"
    default $(dt_compat_enabled,$(DT_COMPAT_ZPT_ROUTE_BEHAVIOR))
    depends on ZMK_POINTING_TOOLS_PIPELINE
    help
      Select a named router pipeline while a behavior binding is held, then
      restore the newest remaining explicit override or the active layer route.

config ZMK_POINTING_TOOLS_ROUTER_MAX_EXPLICIT_ROUTES
    int "Maximum simultaneous explicit routes per pointing router"
    default 4
    range 1 16
    depends on ZMK_POINTING_TOOLS_PIPELINE

config ZMK_POINTING_TOOLS_DEVICE_TABLE
    bool "Physical pointing device discovery table"
    default $(dt_compat_enabled,$(DT_COMPAT_ZPT_DEVICE_TABLE))
    help
      Describe physical pointing devices independently of pipelines and
      tuning targets: stable cross-half identities, owning split half, and
      supported CPI capabilities. Discovery, preview, and split-routed
      sensor control build on this table.

      Deliberately free of ZMK dependencies so the unit-test app builds it
      against plain Zephyr, on both split halves.

config ZMK_POINTING_TOOLS_SENSOR_TUNNEL
    bool "Split-routed sensor control tunnel"
    default $(dt_compat_enabled,$(DT_COMPAT_ZPT_SENSOR_TUNNEL))
    depends on ZMK_POINTING_TOOLS_DEVICE_TABLE
    depends on ZMK_SPLIT
    help
      Relay CPI discovery and preview requests for peripheral-owned devices
      through ZMK's split behavior invocation, and return outcomes as packed
      relative input events on the peripheral's zmk,input-split channel.
      Peripherals build the agent behavior; the central builds the proxy.

config ZMK_POINTING_TOOLS_SENSOR_CONTROL_PAW32XX
    bool "PAW32XX native sensor-control adapter"
    default $(dt_compat_enabled,$(DT_COMPAT_ZPT_PAW3222))
    depends on PAW3222
    depends on ZMK_POINTING_TOOLS_DEVICE_TABLE
    help
      Bind device-table entries whose sensor is a PAW3222 to the driver's
      register-level resolution setter, so previews reach the hardware
      instead of the RAM-only fallback. Requires the zmk-driver-paw3222
      module in the workspace.

config ZMK_POINTING_TOOLS_COMPACT_SPLIT_CODEC
    bool
    default y if ZMK_POINTING_TOOLS_PIPELINE || ZMK_POINTING_TOOLS_COMPACT_SPLIT_ENCODER

config ZMK_POINTING_TOOLS_COMPACT_SPLIT_ENCODER
    bool "Compact complete-frame split transport encoder"
    default $(dt_compat_enabled,$(DT_COMPAT_ZPT_COMPACT_SPLIT_ENCODER))
    depends on ZMK_POINTING
    help
      Encode one complete signed X/Y frame into one split input event on a
      peripheral. A composable central-side pipeline ingress provides the
      matching decoder with cadence and sequence diagnostics.

config ZMK_POINTING_TOOLS_TELEMETRY
    bool "Pointing telemetry and tuning host service"
    default $(dt_compat_enabled,$(DT_COMPAT_ZPT_TELEMETRY))
    # Only where a transport can be enabled: USB serial with its chosen
    # port, or Bluetooth on a keyboard or split central. A split peripheral
    # without USB serial builds without the service.
    depends on ($(dt_chosen_enabled,$(DT_CHOSEN_ZPT_TELEMETRY_UART)) && SERIAL && UART_INTERRUPT_DRIVEN) || \
               (ZMK_BLE && (!ZMK_SPLIT || ZMK_SPLIT_ROLE_CENTRAL))
    help
      Expose state samples, discovery, and tuning to a host over USB serial,
      Bluetooth GATT, or both. Available only where one of them can run.

if ZMK_POINTING_TOOLS_TELEMETRY

config ZMK_POINTING_TOOLS_RUNTIME_TUNING
    bool "Temporary runtime tuning over the host protocol"
    default y
    help
      Discover targets and preview validated parameter changes. Runtime
      values are never persisted and return to devicetree defaults on reset
      or reboot.

if ZMK_POINTING_TOOLS_RUNTIME_TUNING

config ZMK_POINTING_TOOLS_TUNING_MAX_TARGETS
    int "Maximum runtime tuning targets"
    default 16
    range 1 32

config ZMK_POINTING_TOOLS_STATE_TELEMETRY
    bool "Semantic stage-state telemetry"
    default y
    help
      Optionally expose axis intent, suppression, accumulation, clipping, and
      gesture lifecycle decisions from observed pipeline stages. State
      telemetry remains off until requested by a connected host.

config ZMK_POINTING_TOOLS_INPUT_CAPTURE
    bool "Input capture for trace recording"
    default y if ZMK_POINTING_TOOLS_PIPELINE
    help
      Let a host record the input frames and key presses going into one
      pointing pipeline, with microsecond timing and sensor sample spans,
      so the recording replays through the same stage code on the host.
      Capture stays off until a host starts a recording and stops with the
      host heartbeat; while nothing records, each frame costs one atomic
      read. See docs/protocol.md, "Input capture".

config ZMK_POINTING_TOOLS_INPUT_CAPTURE_MAX_PIPELINES
    int "Maximum recordable pipelines"
    default 8
    range 1 32
    depends on ZMK_POINTING_TOOLS_INPUT_CAPTURE

config ZMK_POINTING_TOOLS_PIPELINE_TELEMETRY_INIT_PRIORITY
    int "Pipeline stage telemetry init priority"
    default 90
    range 41 99
    depends on ZMK_POINTING_TOOLS_STATE_TELEMETRY
    help
      POST_KERNEL priority of measlesbagel,zpt-pipeline-telemetry. It runs
      after the stage providers (KERNEL_INIT_PRIORITY_DEFAULT) so tunable
      stages report state under the target id they registered for tuning.

endif

config ZMK_POINTING_TOOLS_TELEMETRY_UART
    bool "Host protocol over USB serial"
    default $(dt_chosen_enabled,$(DT_CHOSEN_ZPT_TELEMETRY_UART))
    depends on SERIAL
    depends on UART_INTERRUPT_DRIVEN
    help
      Serve the host protocol over the USB CDC-ACM port named by the
      measlesbagel,zpt-telemetry-uart chosen node. On by default when that
      chosen node exists.

config ZMK_POINTING_TOOLS_TELEMETRY_BLE
    bool "Host protocol over Bluetooth GATT"
    default y
    depends on ZMK_BLE
    depends on !ZMK_SPLIT || ZMK_SPLIT_ROLE_CENTRAL
    help
      Serve the host protocol over a custom GATT service on the Bluetooth
      host connection, beside the HID service, so the web tuner can connect
      over Web Bluetooth without a cable. On by default wherever it applies
      (Bluetooth keyboards and split centrals). Requests need an encrypted
      link to a bonded host. Idle cost is near zero: the service isn't
      advertised and sends nothing until a host enables telemetry. See
      docs/protocol.md for the service and characteristic UUIDs.

config ZMK_POINTING_TOOLS_TELEMETRY_BLE_TX_CREDITS
    int "Maximum protocol notifications in flight over Bluetooth"
    default 2
    range 1 16
    depends on ZMK_POINTING_TOOLS_TELEMETRY_BLE
    help
      Notifications handed to the Bluetooth stack and not yet sent. HID
      reports leave on the same connection in order, so one waits behind at
      most this many telemetry notifications. State samples that don't fit in
      the free budget are dropped whole and counted, so every-frame telemetry
      runs at whatever rate the connection sustains.

config ZMK_POINTING_TOOLS_TELEMETRY_QUEUE_SIZE
    int "Maximum queued telemetry samples"
    default 64
    range 8 512

config ZMK_POINTING_TOOLS_TELEMETRY_THREAD_STACK_SIZE
    int "Telemetry worker stack size"
    default 2048 if ZMK_POINTING_TOOLS_TELEMETRY_BLE
    default 1536
    range 1024 4096

config ZMK_POINTING_TOOLS_TELEMETRY_HOST_TIMEOUT_MS
    int "Host heartbeat timeout"
    default 5000
    range 1000 60000
    help
      Stop telemetry if the host disappears without disabling it cleanly.

endif

endmenu
```

## config/west.yml
```yaml
manifest:
  remotes:
    - name: zmkfirmware
      url-base: https://github.com/zmkfirmware
  projects:
    - name: zmk
      remote: zmkfirmware
      revision: fa33e35f11d2b15311973cda9fb89dcd2376888c
      import: app/west.yml
  self:
    path: config
```

## dts/bindings/behaviors/measlesbagel,zpt-behavior-route.yaml
```yaml
# SPDX-License-Identifier: MIT

description: Momentarily override a pointing router with one named pipeline

compatible: "measlesbagel,zpt-behavior-route"

include: zero_param.yaml

properties:
  router:
    type: phandle
    required: true
    description: Pointing router receiving the temporary override

  pipeline:
    type: phandle
    required: true
    description: Pipeline selected from press until release
```

## dts/bindings/behaviors/measlesbagel,zpt-sensor-control.yaml
```yaml
# SPDX-License-Identifier: MIT

description: >
  Split sensor-control agent. On a peripheral half, serves CPI requests the
  central relays through ZMK's split behavior invocation, and reports each
  outcome as a packed relative input event on the split-input channel, where
  the central proxy listens. The node name must be eight characters or fewer.

compatible: "measlesbagel,zpt-sensor-control"

include: zero_param.yaml

properties:
  split-input:
    type: phandle
    description: >
      The zmk,input-split node whose channel carries answers for legacy
      pointing devices that set location instead of split-input. Devices
      with split-input are answered on their own channel, by the half that
      has their sensor, so a shared agent needs no split-input. Use the
      channel the peripheral already sends its sensor motion on: ZMK's
      central only subscribes reliably to one input-split channel per
      peripheral, so answers on a second channel never arrive. The answers
      skip that channel's input processors and use INPUT_REL_MISC, so motion
      on the channel must not use that code.
```

## dts/bindings/input_processors/measlesbagel,zpt-input-processor-compact-split-encoder.yaml
```yaml
# SPDX-License-Identifier: MIT

description: Complete-frame encoder for compact ZMK split pointing transport

compatible: "measlesbagel,zpt-input-processor-compact-split-encoder"

include: ip_zero_param.yaml

properties:
  event-code:
    type: int
    required: true
    description: Relative input event code used to carry the packed frame
```

## dts/bindings/input_processors/measlesbagel,zpt-input-processor-noise-filter.yaml
```yaml
# SPDX-License-Identifier: MIT

description: Vector-aware buffered dead-zone and noise filter

compatible: "measlesbagel,zpt-input-processor-noise-filter"

include: ip_zero_param.yaml

properties:
  tuning-id:
    type: string
    required: true
    description: Stable machine-readable identity used by tuning profiles

  tuning-label:
    type: string
    default: "Noise filter"
    description: Host-facing name used by the runtime tuner

  enabled:
    type: boolean
    description: Enable qualification; when absent all complete vectors pass unchanged

  activation-distance:
    type: int
    required: true
    description: Radial net displacement required to qualify intentional movement

  coherence-percent:
    type: int
    required: true
    description: Minimum rotation-invariant directional coherence from 0 through 100

  qualification-timeout-ms:
    type: int
    required: true
    description: Maximum time allowed for pending movement to qualify

  idle-timeout-ms:
    type: int
    required: true
    description: Gap after which active movement must qualify again

  suppress-after-keypress-ms:
    type: int
    description: Ignore movement for this duration after each physical key press
```

## dts/bindings/input_processors/measlesbagel,zpt-input-processor-pipeline.yaml
```yaml
# SPDX-License-Identifier: MIT

description: Frame-aware source ingress backed by one pipeline provider

compatible: "measlesbagel,zpt-input-processor-pipeline"

include: ip_zero_param.yaml

properties:
  source-id:
    type: int
    required: true
    description: Stable identity for raw motion received by this ingress

  resolution-cpi:
    type: int
    required: true
    description: Compiled sensor resolution used for source metadata

  pipeline:
    type: phandle
    required: true
    description: Named pipeline provider receiving reconstructed source frames

  transported:
    type: boolean
    description: Mark source frames as having crossed split transport

  compact-event-code:
    type: int
    description: Relative event code carrying a compact complete split frame

  compact-transport-coalesced:
    type: boolean
    description: Mark decoded compact frames as source-coalesced
```

## dts/bindings/input_processors/measlesbagel,zpt-input-processor-scroll.yaml
```yaml
# SPDX-License-Identifier: MIT

description: Frame-aware synchronized X/Y to horizontal/vertical scroll processor

compatible: "measlesbagel,zpt-input-processor-scroll"

include: ip_one_param.yaml

properties:
  scale-multiplier:
    type: int
    required: true
    description: Numerator used to scale accumulated movement into wheel movement

  scale-divisor:
    type: int
    required: true
    description: Denominator used to scale accumulated movement into wheel movement

  report-interval-ms:
    type: int
    required: true
    description: Interval over which physical frames are coalesced

  idle-timeout-ms:
    type: int
    required: true
    description: Inactivity duration that starts a new directional gesture

  intent-window-ms:
    type: int
    required: true
    description: Decaying time window used for adaptive directional classification

  activation-distance:
    type: int
    required: true
    description: Accumulated movement required before adaptive classification

  engage-ratio-percent:
    type: int
    required: true
    description: Dominant-to-minor ratio that engages an axis lock

  release-ratio-percent:
    type: int
    required: true
    description: Dominant-to-minor ratio below which an axis lock is released

  discard-unclassified:
    type: boolean
    description: Discard short gestures that end before activation distance is reached

  suppress-after-keypress-ms:
    type: int
    description: Ignore movement for this duration after each physical key press
```
