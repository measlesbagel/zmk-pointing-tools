## dts/bindings/measlesbagel,zpt-stage-coherent-displacement.yaml
```yaml
# SPDX-License-Identifier: MIT

description: Coherent displacement motion-gate stage over normalized motion

compatible: "measlesbagel,zpt-stage-coherent-displacement"

include: measlesbagel,zpt-stage-base.yaml

properties:
  enabled:
    type: boolean
    description: Enable qualification; when absent complete vectors bypass the gate

  activation-distance-micrometers:
    type: int
    required: true
    description: Radial net displacement required to qualify intentional movement

  coherence-percent:
    type: int
    required: true
    description: Rotation-invariant directional coherence, 1-100, or 0 to disable

  qualification-timeout-ms:
    type: int
    required: true
    description: Maximum time allowed for pending movement to qualify

  idle-timeout-ms:
    type: int
    required: true
    description: Gap after which active movement must qualify again
```

## dts/bindings/measlesbagel,zpt-stage-cursor-acceleration.yaml
```yaml
# SPDX-License-Identifier: MIT

description: |
  Cursor acceleration stage over normalized motion. Scales each frame by a
  sensitivity read from a curve through eight control points: point N pairs
  curve-speeds-mm-per-s[N] with curve-sensitivity-percent[N]. Between points
  the curve is a smooth monotone cubic that never overshoots a point; before
  the first point and after the last it stays flat. Sensitivities are percent
  of the cursor-transfer gain, so a curve with every point at 100 turns
  acceleration off. The defaults suit a 684 CPI trackball: 65 percent for slow
  aiming, rising through 100 percent around 45 mm/s to 283 percent for fast
  flicks.

  Ball speed is measured per frame and smoothed with speed-rise-ms while the
  ball speeds up and speed-fall-ms while it slows down. Place the stage
  before cursor-transfer so speeds are ball speeds.

compatible: "measlesbagel,zpt-stage-cursor-acceleration"

include: measlesbagel,zpt-stage-base.yaml

properties:
  curve-speeds-mm-per-s:
    type: array
    default: [0, 8, 20, 45, 90, 160, 260, 400]
    description: >
      Ball speed of each of the eight curve points, strictly increasing,
      from 0 to 10000.

  curve-sensitivity-percent:
    type: array
    default: [65, 66, 73, 99, 159, 225, 264, 283]
    description: >
      Sensitivity at each of the eight curve points, from 1 to 1000 percent of
      the cursor-transfer gain.

  speed-rise-ms:
    type: int
    default: 10
    description: >
      Time constant with which the speed estimate follows the ball speeding
      up, from 1 to 200. Shorter makes flicks accelerate sooner; longer
      smooths jitter.

  speed-fall-ms:
    type: int
    default: 5
    description: >
      Time constant with which the speed estimate follows the ball slowing
      down, from 1 to 200. Shorter stops the cursor overshooting when you stop
      to aim.
```

## dts/bindings/measlesbagel,zpt-stage-cursor-coalescer.yaml
```yaml
# SPDX-License-Identifier: MIT

description: |
  Cursor report coalescer over pointer deltas. Sends at most one report per
  report-interval-ms, summing motion in between; motion after a quiet interval
  goes out at once. Place it after cursor-quantizer.

compatible: "measlesbagel,zpt-stage-cursor-coalescer"

include: measlesbagel,zpt-stage-base.yaml

properties:
  report-interval-ms:
    type: int
    required: true
    description: Shortest time between cursor reports; 0 sends every frame
```

## dts/bindings/measlesbagel,zpt-stage-cursor-quantizer.yaml
```yaml
# SPDX-License-Identifier: MIT

description: >
  Cursor quantizer stage converting normalized motion to pointer deltas. The
  output factor is derived from each frame's resolution-CPI (1:1 with the
  sensor), so no units-per-meter property is needed.

compatible: "measlesbagel,zpt-stage-cursor-quantizer"

include: measlesbagel,zpt-stage-base.yaml
```

## dts/bindings/measlesbagel,zpt-stage-cursor-transfer.yaml
```yaml
# SPDX-License-Identifier: MIT

description: Cursor base gain transfer stage over normalized motion

compatible: "measlesbagel,zpt-stage-cursor-transfer"

include: measlesbagel,zpt-stage-base.yaml

properties:
  scale-multiplier:
    type: int
    required: true
    description: Base gain multiplier applied to Q16 millimetre motion

  scale-divisor:
    type: int
    required: true
    description: Base gain divisor applied to Q16 millimetre motion
```

## dts/bindings/measlesbagel,zpt-stage-orientation.yaml
```yaml
# SPDX-License-Identifier: MIT

description: Exact orthogonal physical mounting orientation stage

compatible: "measlesbagel,zpt-stage-orientation"

include: measlesbagel,zpt-stage-base.yaml

properties:
  swap-xy:
    type: boolean
    description: Swap physical X and Y before applying logical inversions

  invert-x:
    type: boolean
    description: Invert the oriented logical X axis

  invert-y:
    type: boolean
    description: Invert the oriented logical Y axis
```

## dts/bindings/measlesbagel,zpt-stage-raw-pointer-identity.yaml
```yaml
# SPDX-License-Identifier: MIT

description: Raw-count to whole pointer-delta identity stage

compatible: "measlesbagel,zpt-stage-raw-pointer-identity"

include: measlesbagel,zpt-stage-base.yaml
```

## dts/bindings/measlesbagel,zpt-stage-resolution-normalize.yaml
```yaml
# SPDX-License-Identifier: MIT

description: Nominal source resolution to Q16 millimetre normalization stage

compatible: "measlesbagel,zpt-stage-resolution-normalize"

include: measlesbagel,zpt-stage-base.yaml
```

## dts/bindings/measlesbagel,zpt-stage-scroll-batcher.yaml
```yaml
# SPDX-License-Identifier: MIT

description: Scroll batcher stage emitting wheel steps on a report deadline

compatible: "measlesbagel,zpt-stage-scroll-batcher"

include: measlesbagel,zpt-stage-base.yaml

properties:
  steps-per-meter:
    type: int
    required: true
    description: Wheel steps emitted per metre of constrained motion at each report flush

  report-interval-ms:
    type: int
    required: true
    description: Interval between armed report flushes

  suppression:
    type: phandle
    description: Keypress suppression policy clearing pending motion while active
```

## dts/bindings/measlesbagel,zpt-stage-text-nav.yaml
```yaml
# SPDX-License-Identifier: MIT

description: Text-navigation stage emitting actions from threshold crossings

compatible: "measlesbagel,zpt-stage-text-nav"

include: measlesbagel,zpt-stage-base.yaml

properties:
  horizontal-threshold-micrometers:
    type: int
    required: true
    description: Distance required to emit a horizontal text action

  vertical-threshold-micrometers:
    type: int
    required: true
    description: Distance required to emit a vertical text action

  idle-timeout-ms:
    type: int
    required: true
    description: Gap after which the gesture accumulator resets

  activation-distance-micrometers:
    type: int
    required: true
    description: Total accumulated distance required to engage an axis

  engage-ratio-percent:
    type: int
    required: true
    description: Major axis dominance required to engage an axis
```

## dts/bindings/measlesbagel,zpt-telemetry.yaml
```yaml
# SPDX-License-Identifier: MIT

description: |
  Host-facing telemetry and tuning service for ZMK Pointing Tools. It runs the
  host protocol over the USB serial port named by the optional
  measlesbagel,zpt-telemetry-uart chosen node and, on Bluetooth keyboards and
  split centrals, over Bluetooth GATT (CONFIG_ZMK_POINTING_TOOLS_TELEMETRY_BLE).

compatible: "measlesbagel,zpt-telemetry"
```
